// This file was generated from a template. Edit it to match your keyboard.
// See https://docs.zephyrproject.org/3.5.0/hardware/porting/board_porting.html
// and https://docs.zephyrproject.org/3.5.0/hardware/pinctrl/index.html for
// more instructions.

// rp2040_4x4-pinctrl.dtsi
// Pin control configuration for RP2040 4x4 keypad
// See Zephyr pinctrl docs: https://docs.zephyrproject.org/latest/hardware/pinctrl/index.html

#include <dt-bindings/pinctrl/rpi-pico-rp2040-pinctrl.h>

&pinctrl {
    kscan0_default: kscan0_default {
        group1 {
            pinmux = <PIO0_P21>, <PIO0_P22>, <PIO0_P23>, <PIO0_P24>;
        };
        group2 {
            pinmux = <PIO0_P15>, <PIO0_P16>, <PIO0_P17>, <PIO0_P20>;
            bias-pull-down;
        };
    };
};

